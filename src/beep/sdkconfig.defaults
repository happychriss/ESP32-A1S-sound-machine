## src/beep/sdkconfig.defaults
```kconfig
CONFIG_IDF_TARGET="esp32"
CONFIG_ESP_CONSOLE_UART_DEFAULT=y
CONFIG_ESP_CONSOLE_UART_BAUDRATE=115200
CONFIG_CODEC_ES8388_SUPPORT=y
```

## src/hello-world/sdkconfig.defaults
```kconfig
# Target: ESP32 (not S3)
CONFIG_IDF_TARGET="esp32"

# Serial output on UART0 (GPIO1 TX, GPIO3 RX) at 115200
CONFIG_ESP_CONSOLE_UART_DEFAULT=y
CONFIG_ESP_CONSOLE_UART_BAUDRATE=115200
```

## src/player/sdkconfig.defaults
```kconfig
CONFIG_IDF_TARGET="esp32"
CONFIG_ESP_CONSOLE_UART_DEFAULT=y
CONFIG_ESP_CONSOLE_UART_BAUDRATE=115200
CONFIG_CODEC_ES8388_SUPPORT=y

# FreeRTOS — larger stack for audio decode
CONFIG_ESP_MAIN_TASK_STACK_SIZE=8192

# Bluetooth — Classic BT only (A2DP sink), no BLE
CONFIG_BT_ENABLED=y
CONFIG_BT_CLASSIC_ENABLED=y
CONFIG_BT_A2DP_ENABLE=y
CONFIG_BTDM_CTRL_MODE_BR_EDR_ONLY=y
CONFIG_BT_BLE_ENABLED=n

# Custom partition table — 3 MB factory (BT stack is large)
CONFIG_PARTITION_TABLE_CUSTOM=y
CONFIG_PARTITION_TABLE_CUSTOM_FILENAME="partitions.csv"
CONFIG_ESPTOOLPY_FLASHSIZE_4MB=y
CONFIG_ESPTOOLPY_FLASHSIZE="4MB"
```
